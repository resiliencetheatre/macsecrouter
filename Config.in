## Config.in
```kconfig
source "$BR2_EXTERNAL_macsecrouter_PATH/package/libnitrokey/Config.in"
source "$BR2_EXTERNAL_macsecrouter_PATH/package/nkmacsec/Config.in"
source "$BR2_EXTERNAL_macsecrouter_PATH/package/python-argparse/Config.in"
source "$BR2_EXTERNAL_macsecrouter_PATH/package/python-dateutils/Config.in"
source "$BR2_EXTERNAL_macsecrouter_PATH/package/python-taky/Config.in"
source "$BR2_EXTERNAL_macsecrouter_PATH/package/gwsocket/Config.in"
source "$BR2_EXTERNAL_macsecrouter_PATH/package/highrate/Config.in"
source "$BR2_EXTERNAL_macsecrouter_PATH/package/curlcot/Config.in"
source "$BR2_EXTERNAL_macsecrouter_PATH/package/cotsim/Config.in"
source "$BR2_EXTERNAL_macsecrouter_PATH/package/tacmsgrouter/Config.in"
source "$BR2_EXTERNAL_macsecrouter_PATH/package/rpiboot/Config.in"
source "$BR2_EXTERNAL_macsecrouter_PATH/package/audioreceiver/Config.in"
source "$BR2_EXTERNAL_macsecrouter_PATH/package/audiostreamer/Config.in"
source "$BR2_EXTERNAL_macsecrouter_PATH/package/modmodem/Config.in"
source "$BR2_EXTERNAL_macsecrouter_PATH/package/udp2raw/Config.in"
source "$BR2_EXTERNAL_macsecrouter_PATH/package/rtptun/Config.in"
source "$BR2_EXTERNAL_macsecrouter_PATH/package/udpspeeder/Config.in"
```
